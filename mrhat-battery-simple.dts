/*
* Copyright (C) 2024 Effective Range Kft.
*
* This program is free software; you can redistribute it and/or modify
* it under the terms of the GNU General Public License version 2 as
* published by the Free Software Foundation.
*/
/dts-v1/;
/plugin/;

/* Reference values taken from  EB535151VU  /drivers/power/supply/samsung-sdi-battery.c */
/ {
    compatible = "brcm,bcm2835";
    fragment@0{
        target-path = "/";
        __overlay__ {
            status = "okay";
            BAT1: battery {
                compatible = "simple-battery";
                constant-charge-current-max-microamp = <1749000>;
                constant-charge-voltage-max-microvolt = <4200000>;
                precharge-current-microamp = <133000>;
                charge-term-current-microamp = <133000>;
                charge-full-design-microamp-hours = <5300000>;
                device-chemistry = "lithium-ion";
                factory-internal-resistance-micro-ohms = <100000>;
                factory-internal-resistance-charging-micro-ohms = <400000>;
                /* Voltage [uV] Resistance [uOhm]     */        
                vbat-to-internal-resistance-discharging-table = 
                    < 4071000  100000 >,
                    < 4019000  118354 >,
                    < 3951000  120886 >,
                    < 3901000  122151 >,
                    < 3850000  172784 >,
                    < 3800000  193037 >,
                    < 3750000  129746 >,
                    < 3700000  183544 >,
                    < 3650000  165822 >,
                    < 3618000  183544 >,
                    < 3505000  148734 >,
                    < 3484000  160126 >,
                    < 3413000  153797 >,
                    < 3393000  180379 >,
                    < 3361000  177848 >,
                    < 3302000  181012 >,
                    < 3280000  158227 >;
                /* Voltage [uV] Resistance [uOhm]     */        
                vbat-to-internal-resistance-charging-table =
                	<4190000 400000>,
                    <4159000 471028>,
                    <4121000 457943>,
                    <4069000 426168>,
                    <4046000 428037>,
                    <4026000 435514>,
                    <4007000 448598>,
                    <3982000 543925>,
                    <3945000 515887>,
                    <3924000 497196>,
                    <3910000 482242>,
                    <3900000 506542>,
                    <3844000 521495>,
                    <3772000 405607>,
                    <3673000 388785>,
                    <3571000 388785>,
                    <3510000 426168>;
                /* this is an array of temperature in descending order, and 
                * as the number of  ocv-capacity-table-X tables corresponds to
                * ocv-capacity-celsius[X] temperature
                */
                ocv-capacity-celsius = <250>;
                ocv-capacity-table-0 = 
                    <4200000 100>,
                    <4180000 98>,
                    <4160000 96>,
                    <4140000 94>,
                    <4120000 92>,
                    <4100000 90>,
                    <4080000 88>,
                    <4060000 86>,
                    <4040000 84>,
                    <4020000 82>,
                    <4000000 80>,
                    <3980000 78>,
                    <3960000 76>,
                    <3940000 74>,
                    <3920000 72>,
                    <3900000 70>,
                    <3880000 68>,
                    <3860000 66>,
                    <3840000 64>,
                    <3820000 62>,
                    <3800000 60>,
                    <3780000 58>,
                    <3760000 56>,
                    <3740000 54>,
                    <3720000 52>,
                    <3700000 50>,
                    <3680000 48>,
                    <3660000 46>,
                    <3640000 44>,
                    <3620000 42>,
                    <3600000 40>,
                    <3580000 38>,
                    <3560000 36>,
                    <3540000 34>,
                    <3520000 32>,
                    <3500000 30>,
                    <3480000 28>,
                    <3460000 26>,
                    <3440000 24>,
                    <3420000 22>,
                    <3400000 20>,
                    <3380000 18>,
                    <3360000 16>,
                    <3340000 14>,
                    <3320000 12>,
                    <3300000 10>,
                    <3280000 9>,
                    <3260000 8>,
                    <3240000 7>,
                    <3220000 6>,
                    <3200000 5>,
                    <3180000 4>,
                    <3160000 3>,
                    <3140000 2>,
                    <3120000 1>,
                    <3000000 0>;

                /* generic LiIon resistance change over temperature */        
                /* Temperature [0.1 C] Percentage of resistance     */        
                resistance-temp-table = 
                     <500 45>,
                     <400 60>,
                     <350 100>,
                     <150 100>,
                     <100 150>,
                     < 0  200>;
            };
        };
    };

    fragment@1{
        target-path = "/";
        __overlay__ {
            status = "okay";
            aliases {
                BAT1 = <&BAT1>;
            };
        };
    };
    
    fragment@2{
        target-path = "/";
        __overlay__ {
            status = "okay";
            __symbols__ {
                BAT1 = "/battery";
            };
        };
    };

    __overrides__ {
        max_charge_uA = <&BAT1>, "constant-charge-current-max-microamp:0";
        max_charge_uV = <&BAT1>, "constant-charge-voltage-max-microvolt:0";
        pre_charge_uA = <&BAT1>, "precharge-current-microamp:0";
        charge_term_uA = <&BAT1>, "charge-term-current-microamp:0";
        bat_capacity_uAh = <&BAT1>, "charge-full-design-microamp-hours:0";
    };
};